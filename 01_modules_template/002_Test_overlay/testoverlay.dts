/dts-v1/;
/plugin/;
/ {
	compatible = "brcm,bcm2835";
	fragment@0{
		target-path = "/";
		__overlay__{
			 my_device: my_device{
				 compatible = "overlay_Test_module";
				 status = "okay";
				 label = "Re-test OVERLAY";
				 my_value = <100>;
			};
		};
	};
};

